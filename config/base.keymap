/*
     _____        __ _          _   __           _                         _
    /  ___|      / _| |        | | / /          | |                       | |
    \ `--.  ___ | |_| | ___    | |/ /  ___ _   _| |__   ___   __ _ _ __ __| |
     `--. \/ _ \|  _| |/ _ \   |    \ / _ \ | | | '_ \ / _ \ / _` | '__/ _` |
    /\__/ / (_) | | | |  __/   | |\  \  __/ |_| | |_) | (_) | (_| | | | (_| |
    \____/ \___/|_| |_|\___|   \_| \_/\___|\__, |_.__/ \___/ \__,_|_|  \__,_|
                                            __/ |
                                           |___/
*/
#include <behaviors.dtsi>
#include <dt-bindings/zmk/bt.h>
#include <dt-bindings/zmk/ext_power.h>
#include <dt-bindings/zmk/keys.h>
#include <dt-bindings/zmk/rgb.h>
#include <dt-bindings/zmk/outputs.h>

#define BASE 0
#define LOWER 1
#define RAISE 2
#define ADJUST 3
#define SYS 4
#define FN 5

// Make the keymap section less noisy
#define XXX &none
#define ___ &trans

#include "matrix.h"
#include "keycodes.h"
#include "helpers.h"
#include "mouse.dtsi"
#include "combos.dtsi"

/* Global defaults */

/*
  Enables holding the first mod-tap key
  by performing a tap-release-hold sequence.
  To use it: "&qt KEYCODE1 KEYCODE2"
*/
ZMK_HOLD_TAP(quick_tap,
    flavor          = "tap-preferred";
    tapping-term-ms = <200>;
    quick-tap-ms    = <200>;
    bindings        = <&kp>, <&kp>;
)

/*
  Pressing the key on its own will send a Backspace keycode
  but pressing it while a shift or GUI modifier is held sends the Delete
  keycode instead
*/
ZMK_MOD_MORPH(backdel,
    bindings = <&kp BACKSPACE>, <&kp DELETE>;
    mods     = <(MOD_LGUI|MOD_LSFT|MOD_RGUI|MOD_RSFT)>;
)



/*
  Pressing the key on its own will send an @ keycode
  but pressing it while a shift modifier is held sends
  the corresponding Alt Code keycode combination instead
*/
ZMK_MOD_MORPH(at,
    bindings = <&kp IT_AT>, <&alt_at>;
    mods     = <(MOD_LSFT|MOD_RSFT)>;
)

/*
  Pressing the key on its own will send a ~ keycode
  but pressing it while a shift modifier is held sends
  the corresponding Alt Code keycode combination instead
*/
ZMK_MOD_MORPH(tilde,
    bindings = <&kp IT_TILDE>, <&alt_tilde>;
    mods     = <(MOD_LSFT|MOD_RSFT)>;
)

/*
  Pressing the key on its own will send a # keycode
  but pressing it while a shift modifier is held sends
  the corresponding Alt Code keycode combination instead
*/
ZMK_MOD_MORPH(hash,
    bindings = <&kp IT_HASH>, <&alt_hash>;
    mods     = <(MOD_LSFT|MOD_RSFT)>;
)

/*
  Pressing the key on its own will send a ` keycode
  but pressing it while a shift modifier is held sends
  the corresponding Alt Code keycode combination instead
*/
ZMK_MOD_MORPH(bktk,
    bindings = <&kp IT_BKTK>, <&alt_bktk>;
    mods     = <(MOD_LSFT|MOD_RSFT)>;
)

// Activate ADJUST layer by pressing raise and lower
ZMK_CONDITIONAL_LAYER(adjust, LOWER RAISE, ADJUST)

// Turn off Windows
ZMK_MACRO(win_off,
    wait-ms = <40>;
    tap-ms  = <40>;
    bindings = <&macro_press     &kp LWIN>
               , <&macro_tap     &kp X>
               , <&macro_release &kp LWIN>
               , <&macro_tap     &kp U &kp U>;
)

// Custom macro to generate @ using the alt code table
ZMK_MACRO(alt_at,
    wait-ms = <40>;
    tap-ms  = <40>;
    bindings = <&macro_press     &kp LALT>
               , <&macro_tap     WIN_AT>
               , <&macro_release &kp LALT>;
)


// Custom macro to generate # using the alt code table
ZMK_MACRO(alt_hash,
    wait-ms = <40>;
    tap-ms  = <40>;
    bindings = <&macro_press     &kp LALT>
               , <&macro_tap     WIN_HASH>
               , <&macro_release &kp LALT>;
)

// Custom macro to generate ~ using the alt code table
ZMK_MACRO(alt_tilde,
    wait-ms = <40>;
    tap-ms  = <40>;
    bindings = <&macro_press     &kp LALT>
               , <&macro_tap     WIN_TILDE>
               , <&macro_release &kp LALT>;
)

// Custom macro to generate ` using the alt code table
ZMK_MACRO(alt_bktk,
    wait-ms = <40>;
    tap-ms  = <40>;
    bindings = <&macro_press     &kp LALT>
               , <&macro_tap     WIN_TILDE>
               , <&macro_release &kp LALT>;
)

// Rotator encoder customization
ZMK_ROTATOR_ENCODER(scroll_encoder,
    bindings = <&msc SCRL_DOWN>, <&msc SCRL_UP>;
    tap-ms   = <100>;
)


// ╭─────────┬─────────┬─────────┬─────────┬─────────┬─────────╮                                 ╭─────────┬─────────┬─────────┬─────────┬─────────┬─────────╮
// │ ESC     │  1      │ 2       │ 3       │ 4       │ 5       │                                 │ 6       │ 7       │ 8       │ 9       │ 0       │BACKSPACE│
// ├─────────┼─────────┼─────────┼─────────┼─────────┼─────────┤                                 ├─────────┼─────────┼─────────┼─────────┼─────────┼─────────┤
// │ TAB     │  Q      │ W       │ E       │ R       │ T       │                                 │ Y       │ U       │ I       │ O       │ P       │         │
// ├─────────┼─────────┼─────────┼─────────┼─────────┼─────────┤                                 ├─────────┼─────────┼─────────┼─────────┼─────────┼─────────┤
// │ CAPS    │  A      │ S       │ D       │ F       │ G       │                                 │ H       │ J       │ K       │ L       │ ;       │         │
// ├─────────┼─────────┼─────────┼─────────┼─────────┼─────────┼─────────╮             ╭─────────┼─────────┼─────────┼─────────┼─────────┼─────────┼─────────┤
// │ LSHIFT  │  Z      │ X       │ C       │ V       │ B       │ MUTE    │             │↑↓  ←  → │ N       │ M       │ ,       │ .       │         │ RSHIFT  │
// ╰─────────┬─────────┬─────────┬─────────┬─────────┬─────────┬─────────╯             ╰─────────┬─────────┬─────────┬─────────┬─────────┬─────────┬─────────╯
//           │  LCTRL  │ LGUI    │ LALT    │ MO(1)   │ SPACE   │                                 │ SPACE   │ ENTER   │ MO(2)   │         │ DELETE  │
//           ╰─────────┴─────────┴─────────┴─────────┴─────────╯                                 ╰─────────┴─────────┴─────────┴─────────┴─────────╯

// NB: I didn't declared a behavior for the gresc keybinding as it is already defined at https://github.com/zmkfirmware/zmk/blob/main/app/dts/behaviors/gresc.dtsi
ZMK_LAYER(master,
    &gresc     &kp N1        &kp N2        &kp N3        &kp N4        &kp N5        &kp UP_ARROW   &kp N6        &kp N7        &kp N8        &kp N9        &kp N0        &kp BACKSPACE
    &kp TAB    &kp Q         &kp W         &kp E         &kp R         &kp T         &kp DOWN_ARROW &kp Y         &kp U         &kp I         &kp O         &kp P         &kp BSLH
    &kp CAPS   &kp A         &kp S         &kp D         &kp F         &kp G         &kp LEFT_ARROW &kp H         &kp J         &kp K         &kp L         &kp SEMI      &kp APOS
    &kp LSHFT  &kp Z         &kp X         &kp C         &kp V         &kp B         &kp RIGHT_ARROW&kp N         &kp M         &kp COMMA     &kp DOT       &kp FSLH      &kp RSHIFT
    &kp C_MUTE &kp LCTRL     &kp LGUI      &kp LALT      &mo LOWER     &kp SPACE     &kp ENTER      &kp SPACE     &kp ENTER     &mo RAISE     &kp RSHIFT    &kp DELETE
    , &inc_dec_kp C_VOLUME_UP C_VOL_DN
)


// ╭─────────┬─────────┬─────────┬─────────┬─────────┬─────────╮                                 ╭─────────┬─────────┬─────────┬─────────┬─────────┬─────────╮
// │ GRAVE   │ F1      │ F2      │ F3      │ F4      │ F5      │                                 │ F6      │ F7      │ F8      │ F9      │ F10     │         │
// ├─────────┼─────────┼─────────┼─────────┼─────────┼─────────┤                                 ├─────────┼─────────┼─────────┼─────────┼─────────┼─────────┤
// │         │ GRAVE   │ M_LCLK  │ M_MCLK  │ M_RCLK  │ NONE    │                                 │ PG_UP   │ HOME    │  ↑      │ END     │ -       │ =       │
// ├─────────┼─────────┼─────────┼─────────┼─────────┼─────────┤                                 ├─────────┼─────────┼─────────┼─────────┼─────────┼─────────┤
// │         │ TILDE   │         │         │         │ NONE    │                                 │ PG_DOWN │ ←       │  ↓      │  →      │ [       │ ]       │
// ├─────────┼─────────┼─────────┼─────────┼─────────┼─────────┼─────────╮             ╭─────────┼─────────┼─────────┼─────────┼─────────┼─────────┼─────────┤
// │         │ RGB_OFF │ RGB_ON  │ RGB_EFF │ RGB_EFR │ RGB_SPI │ MUTE    │             │↑↓  ←  → │ RGB_BRD │ RGB_BRI │ INSERT  │ F11     │ F12     │         │
// ╰─────────┬─────────┬─────────┬─────────┬─────────┬─────────┬─────────╯             ╰─────────┬─────────┬─────────┬─────────┬─────────┬─────────┬─────────╯
//           │         │         │         │         │         │                                 │         │ M_LCLK  │         │         │         │
//           ╰─────────┴─────────┴─────────┴─────────┴─────────╯                                 ╰─────────┴─────────┴─────────┴─────────┴─────────╯
// TODO: Rethink the layout as it seems that some keys are currently wasted
ZMK_LAYER(layer1,
    &gresc       &kp F1        &kp F2        &kp F3        &kp F4        &kp F5       U_MS_U     &kp F6       &kp F7       &kp F8        &kp F9       &kp F10       ___
    ___          &kp GRAVE     &mkp LCLK     &mkp MCLK     &mkp RCLK     XXX          U_MS_D     &kp PG_UP    &kp HOME     &kp UP        &kp END      &kp MINUS     &kp EQUAL
    ___          &tilde        ___           ___           ___           XXX          U_MS_L     &kp PG_DN    &kp LEFT     &kp DOWN      &kp RIGHT    &kp LBKT      &kp RBKT
    ___          U_RGB_OFF     U_RGB_ON      U_RGB_EFF     U_RGB_EFR     U_RGB_SPI    U_MS_R     U_RGB_BRD    U_RGB_BRI    &kp INSERT    &kp F11      &kp F12       ___
    &kp C_MUTE   ___           ___           ___           ___           ___          &mkp LCLK   ___          ___          ___           ___          ___
    , &scroll_encoder
)

// ╭─────────┬─────────┬─────────┬─────────┬─────────┬─────────╮                                 ╭─────────┬─────────┬─────────┬─────────┬─────────┬─────────╮
// │ F1      │ F2      │ F3      │ F4      │ F5      │ F6      │                                 │ F7      │ F8      │ F9      │ F10     │ F11     │ F12     │
// ├─────────┼─────────┼─────────┼─────────┼─────────┼─────────┤                                 ├─────────┼─────────┼─────────┼─────────┼─────────┼─────────┤
// │         │ NONE    │ NONE    │         │         │ OUT_TOG │                                 │         │         │         │         │  _      │ +       │
// ├─────────┼─────────┼─────────┼─────────┼─────────┼─────────┤                                 ├─────────┼─────────┼─────────┼─────────┼─────────┼─────────┤
// │         │ @       │ #       │ ~       │ `       │         │                                 │ <       │ >       │         │         │  [      │ ]       │
// ├─────────┼─────────┼─────────┼─────────┼─────────┼─────────┼─────────╮             ╭─────────┼─────────┼─────────┼─────────┼─────────┼─────────┼─────────┤
// │         │         │         │         │         │         │         │             │↑↓  ←  → │ {       │ }       │ NONE    │ NONE    │ RALT    │         │
// ╰─────────┬─────────┬─────────┬─────────┬─────────┬─────────┬─────────╯             ╰─────────┬─────────┬─────────┬─────────┬─────────┬─────────┬─────────╯
//           │         │         │         │         │         │                                 │         │ M_LCLK  │         │         │         │
//           ╰─────────┴─────────┴─────────┴─────────┴─────────╯                                 ╰─────────┴─────────┴─────────┴─────────┴─────────╯
ZMK_LAYER(layer2,
    &kp F1       &kp F2       &kp F3       &kp F4        &kp F5       &kp F6        U_MS_U     &kp F7       &kp F8       &kp F9       &kp F10      &kp F11       &kp F12
    ___          XXX          XXX          ___           ___          &out OUT_TOG  U_MS_D     ___           ___           ___         ___          &kp UNDER    &kp PLUS
    ___          &at          &hash        &tilde        &bktk        ___           U_MS_L     &kp IT_LESS  &kp IT_GREAT ___           ___          &kp IT_EACU  &kp IT_AST
    ___          ___          ___          ___           ___          ___           U_MS_R     &kp IT_LBKT  &kp IT_RBKT  XXX          XXX          &kp RIGHT_ALT ___
    ___          ___          ___          ___           ___          ___           &mkp LCLK   ___           ___           ___          ___          ___
    , &scroll_encoder
)

// ╭─────────┬─────────┬─────────┬─────────┬─────────┬─────────╮                                 ╭─────────┬─────────┬─────────┬─────────┬─────────┬─────────╮
// │ F1      │ F2      │ F3      │ F4      │ F5      │ F6      │                                 │ F7      │ F8      │ F9      │ F10     │ F11     │ F12     │
// ├─────────┼─────────┼─────────┼─────────┼─────────┼─────────┤                                 ├─────────┼─────────┼─────────┼─────────┼─────────┼─────────┤
// │         │ NONE    │ NONE    │         │         │ OUT_TOG │                                 │         │         │         │         │  _      │ +       │
// ├─────────┼─────────┼─────────┼─────────┼─────────┼─────────┤                                 ├─────────┼─────────┼─────────┼─────────┼─────────┼─────────┤
// │         │ @       │ #       │ ~       │ `       │         │                                 │ <       │ >       │         │         │  [      │ ]       │
// ├─────────┼─────────┼─────────┼─────────┼─────────┼─────────┼─────────╮             ╭─────────┼─────────┼─────────┼─────────┼─────────┼─────────┼─────────┤
// │         │ RGB_OFF │ RGB_ON  │ RGB_EFF │ RGB_EFR │ RGB_SPI │ MUTE    │             │↑↓  ←  → │ RGB_BRD │ RGB_BRI │         │         │         │         │
// ╰─────────┬─────────┬─────────┬─────────┬─────────┬─────────┬─────────╯             ╰─────────┬─────────┬─────────┬─────────┬─────────┬─────────┬─────────╯
//           │         │         │         │         │         │                                 │         │ M_LCLK  │         │         │         │
//           ╰─────────┴─────────┴─────────┴─────────┴─────────╯                                 ╰─────────┴─────────┴─────────┴─────────┴─────────╯
ZMK_LAYER(adjust,
    &kp F1       &kp F2       &kp F3       &kp F4        &kp F5      &kp F6        U_MS_U     &kp F7       &kp F8         &kp F9     &kp F10      &kp F11      &kp F12
    ___          XXX          XXX          ___           ___         &out OUT_TOG  U_MS_D     ___          ___            ___        ___          &kp UNDER    &kp PLUS
    ___          &at          &hash        &tilde        &bktk        ___          U_MS_L     &kp IT_LESS  &kp IT_GREAT   ___        ___          &kp IT_EACU  &kp IT_AST
    ___          U_RGB_OFF    U_RGB_ON     U_RGB_EFF     U_RGB_EFR   U_RGB_SPI     U_MS_R     U_RGB_BRD    U_RGB_BRI      ___        ___          ___         ___
    ___          ___          ___          ___           ___         ___           &mkp LCLK  ___          ___            ___        ___          ___
    , &scroll_encoder
)
